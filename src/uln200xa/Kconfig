## src/uln200xa/Kconfig
```kconfig
config UPM_uln200xa
    bool "uln200xa"
    select MRAA
    select NEWLIB_LIBC
    depends on UPM
    default n
    help
        upm ULN200XA Stepper Motor
```

## src/urm37/Kconfig
```kconfig
config UPM_urm37
    bool "urm37"
    select MRAA
    select NEWLIB_LIBC
    depends on UPM
    default n
    help
        upm URM37 Ultrasonic Ranger
```

## src/utilities/Kconfig
```kconfig
config UPM_utilities
    bool "utilities"
    select MRAA
    select NEWLIB_LIBC
    depends on UPM
    default n
    help
        UPM Utilities Library
```

## src/vdiv/Kconfig
```kconfig
config UPM_vdiv
    bool "vdiv"
    select MRAA
    select NEWLIB_LIBC
    depends on UPM
    default n
    help
        upm grove voltage divider module
```

## src/water/Kconfig
```kconfig
config UPM_water
    bool "water"
    select MRAA
    select NEWLIB_LIBC
    depends on UPM
    default n
    help
        upm water sensor module
```

## src/wfs/Kconfig
```kconfig
config UPM_wfs
    bool "wfs"
    select MRAA
    select NEWLIB_LIBC
    depends on UPM
    default n
    help
        upm WFS (Water Flow Sensor)
```

## src/yg1006/Kconfig
```kconfig
config UPM_yg1006
    bool "yg1006"
    select MRAA
    select NEWLIB_LIBC
    depends on UPM
    default n
    help
        upm yg1006 flame sensor
```
