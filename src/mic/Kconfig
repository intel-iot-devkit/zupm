## src/mic/Kconfig
```kconfig
config UPM_mic
    bool "mic"
    select MRAA
    select NEWLIB_LIBC
    depends on UPM
    default n
    help
        Simple Microphone API
```

## src/mma7361/Kconfig
```kconfig
config UPM_mma7361
    bool "mma7361"
    select MRAA
    select NEWLIB_LIBC
    depends on UPM
    default n
    help
        upm dfrobot MMA7361 analog accelerometer
```

## src/mma7660/Kconfig
```kconfig
config UPM_mma7660
    bool "mma7660"
    select MRAA
    select NEWLIB_LIBC
    depends on UPM
    default n
    help
        upm MMA7660 I2C Accelerometer (1.5g)
```

## src/moisture/Kconfig
```kconfig
config UPM_moisture
    bool "moisture"
    select MRAA
    select NEWLIB_LIBC
    depends on UPM
    default n
    help
        upm analog moisture module
```

## src/mpr121/Kconfig
```kconfig
config UPM_mpr121
    bool "mpr121"
    select MRAA
    select NEWLIB_LIBC
    depends on UPM
    default n
    help
        upm mpr121sensor module
```

## src/mq303a/Kconfig
```kconfig
config UPM_mq303a
    bool "mq303a"
    select MRAA
    select NEWLIB_LIBC
    depends on UPM
    default n
    help
        upm mq303a sensor module
```

## src/ms5803/Kconfig
```kconfig
config UPM_ms5803
    bool "ms5803"
    select MRAA
    select NEWLIB_LIBC
    depends on UPM
    default n
    help
        upm MS5803 Pressure and Temperature sensor
```

## src/my9221/Kconfig
```kconfig
config UPM_my9221
    bool "my9221"
    select MRAA
    select NEWLIB_LIBC
    depends on UPM
    default n
    help
        upm MY9221 LED Controller
```

## src/nmea_gps/Kconfig
```kconfig
config UPM_nmea_gps
    bool "nmea_gps"
    select MRAA
    select NEWLIB_LIBC
    depends on UPM
    default n
    help
        UPM Generic driver for GPS NMEA sensors
```

## src/nunchuck/Kconfig
```kconfig
config UPM_nunchuck
    bool "nunchuck"
    select MRAA
    select NEWLIB_LIBC
    depends on UPM
    default n
    help
        upm NUNCHUCK controller
```

## src/o2/Kconfig
```kconfig
config UPM_o2
    bool "o2"
    select MRAA
    select NEWLIB_LIBC
    depends on UPM
    default n
    help
        upm O2 oxygen concentration sensor module
```

## src/otp538u/Kconfig
```kconfig
config UPM_otp538u
    bool "otp538u"
    select MRAA
    select NEWLIB_LIBC
    depends on UPM
    default n
    help
        upm OTP538U IR Temperature Sensor
```

## src/ppd42ns/Kconfig
```kconfig
config UPM_ppd42ns
    bool "ppd42ns"
    select MRAA
    select NEWLIB_LIBC
    depends on UPM
    default n
    help
        upm PPD42NS Dust Sensor
```

## src/relay/Kconfig
```kconfig
config UPM_relay
    bool "relay"
    select MRAA
    select NEWLIB_LIBC
    depends on UPM
    default n
    help
        UPM Relay Module: relay
```

## src/rotary/Kconfig
```kconfig
config UPM_rotary
    bool "rotary"
    select MRAA
    select NEWLIB_LIBC
    depends on UPM
    default n
    help
        UPM Relay Module: rotary
```

## src/rotaryencoder/Kconfig
```kconfig
config UPM_rotaryencoder
    bool "rotaryencoder"
    select MRAA
    select NEWLIB_LIBC
    depends on UPM
    default n
    help
        upm Rotary Encoder
```

## src/rpr220/Kconfig
```kconfig
config UPM_rpr220
    bool "rpr220"
    select MRAA
    select NEWLIB_LIBC
    depends on UPM
    default n
    help
        upm RPR220 IR Reflective Sensor
```

## src/servo/Kconfig
```kconfig
config UPM_servo
    bool "servo"
    select MRAA
    select NEWLIB_LIBC
    depends on UPM
    default n
    help
        upm servo module
```

## src/sht1x/Kconfig
```kconfig
config UPM_sht1x
    bool "sht1x"
    select MRAA
    select NEWLIB_LIBC
    depends on UPM
    default n
    help
        UPM driver for the SHT1X temperature/humidity sensor
```

## src/slide/Kconfig
```kconfig
config UPM_slide
    bool "slide"
    select MRAA
    select NEWLIB_LIBC
    depends on UPM
    default n
    help
        Slide potentiometer sensor
```

## src/speaker/Kconfig
```kconfig
config UPM_speaker
    bool "speaker"
    select MRAA
    select NEWLIB_LIBC
    depends on UPM
    default n
    help
        UPM Speaker Module: speaker
```

## src/sx127x/Kconfig
```kconfig
config UPM_sx127x
    bool "sx127x"
    select MRAA
    select NEWLIB_LIBC
    depends on UPM
    default n
    help
        LORA Module

config UPM_sx127x_mac
    bool "sx127x"
    select MRAA
    select NEWLIB_LIBC
    depends on UPM
    default n
    help
        LORA Module mac layer
```

## src/temperature/Kconfig
```kconfig
config UPM_temperature
    bool "temperature"
    select MRAA
    select NEWLIB_LIBC
    depends on UPM
    default n
    help
        Temperature Sensor
```

## src/tsl2561/Kconfig
```kconfig
config UPM_tsl2561
    bool "tsl2561"
    select MRAA
    select NEWLIB_LIBC
    depends on UPM
    default n
    help
        upm tsl2561 Digital Light Sensor
```

## src/ttp223/Kconfig
```kconfig
config UPM_ttp223
    bool "ttp223"
    select MRAA
    select NEWLIB_LIBC
    depends on UPM
    default n
    help
        upm ttp223 touch sensor module
```
