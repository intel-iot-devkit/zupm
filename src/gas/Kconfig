## src/gas/Kconfig
```kconfig
config UPM_gas
    bool "gas"
    select MRAA
    select NEWLIB_LIBC
    depends on UPM
    default n
    help
        Gas sensors
```

## src/gp2y0a/Kconfig
```kconfig
config UPM_gp2y0a
    bool "gp2y0a"
    select MRAA
    select NEWLIB_LIBC
    depends on UPM
    default n
    help
        upm gp2y0a family of IR distance detectors
```

## src/gsr/Kconfig
```kconfig
config UPM_gsr
    bool "gsr"
    select MRAA
    select NEWLIB_LIBC
    depends on UPM
    default n
    help
        upm gsr galvanic skin response sensor module
```

## src/guvas12d/Kconfig
```kconfig
config UPM_guvas12d
    bool "guvas12d"
    select MRAA
    select NEWLIB_LIBC
    depends on UPM
    default n
    help
        upm GUVAS12D Analog UV Sensor
```

## src/hka5/Kconfig
```kconfig
config UPM_hka5
    bool "hka5"
    select MRAA
    select NEWLIB_LIBC
    depends on UPM
    default n
    help
        UPM driver for DFRobot HKA5 PM2.5 particle sensor
```

## src/hmc5883l/Kconfig
```kconfig
config UPM_hmc5883l
    bool "hmc5883l"
    select MRAA
    select NEWLIB_LIBC
    depends on UPM
    default n
    help
        upm HMC5883L Digital Compass
```

## src/ims/Kconfig
```kconfig
config UPM_ims
    bool "ims"
    select MRAA
    select NEWLIB_LIBC
    depends on UPM
    default n
    help
        Catnip Electronics I2C moisture sensor
```

## src/jhd1313m1/Kconfig
```kconfig
config UPM_jhd1313m1
    bool "jhd1313m1"
    select MRAA
    select NEWLIB_LIBC
    depends on UPM
    default n
    help
        upm JHD1313M1 RGB LCD display
```

## src/joystick12/Kconfig
```kconfig
config UPM_joystick12
    bool "joystick12"
    select MRAA
    select NEWLIB_LIBC
    depends on UPM
    default n
    help
        ElecFreaks Joystick 1.2
```

## src/lcm1602/Kconfig
```kconfig
config UPM_lcm1602
    bool "lcm1602"
    select MRAA
    select NEWLIB_LIBC
    depends on UPM
    default n
    help
        upm LCM1602 LCD display
```

## src/ldt0028/Kconfig
```kconfig
config UPM_ldt0028
    bool "ldt0028"
    select MRAA
    select NEWLIB_LIBC
    depends on UPM
    default n
    help
        ldt0028 Piezo Vibration Sensor
```

## src/led/Kconfig
```kconfig
config UPM_led
    bool "led"
    select MRAA
    select NEWLIB_LIBC
    depends on UPM
    default n
    help
        upm led module
```

## src/light/Kconfig
```kconfig
config UPM_light
    bool "light"
    select MRAA
    select NEWLIB_LIBC
    depends on UPM
    default n
    help
        upm light sensor module
```

## src/linefinder/Kconfig
```kconfig
config UPM_linefinder
    bool "linefinder"
    select MRAA
    select NEWLIB_LIBC
    depends on UPM
    default n
    help
        upm LINEFINDER Sensor
```

## src/lis2ds12/Kconfig
```kconfig
config UPM_lis2ds12
    bool "lis2ds12"
    select MRAA
    select NEWLIB_LIBC
    depends on UPM
    default n
    help
        upm LIS2DS12 3-axis Accelerometer
```

## src/lm35/Kconfig
```kconfig
config UPM_lm35
    bool "lm35"
    select MRAA
    select NEWLIB_LIBC
    depends on UPM
    default n
    help
        upm LM35 Analog Temperature Sensor
```

## src/loudness/Kconfig
```kconfig
config UPM_loudness
    bool "loudness"
    select MRAA
    select NEWLIB_LIBC
    depends on UPM
    default n
    help
        upm loudness sensor module
```

## src/lsm303agr/Kconfig
```kconfig
config UPM_lsm303agr
    bool "lsm303agr"
    select MRAA
    select NEWLIB_LIBC
    depends on UPM
    default n
    help
        upm LSM303AGR 3-axis Accelerometer and Magnetometer
```

## src/lsm6ds3h/Kconfig
```kconfig
config UPM_lsm6ds3h
    bool "lsm6ds3h"
    select MRAA
    select NEWLIB_LIBC
    depends on UPM
    default n
    help
        upm LSM6DS3H 3-axis Accelerometer
```

## src/lsm6dsl/Kconfig
```kconfig
config UPM_lsm6dsl
    bool "lsm6dsl"
    select MRAA
    select NEWLIB_LIBC
    depends on UPM
    default n
    help
        upm LSM6DSL 3-axis Accelerometer and Gyroscope
```

## src/m24lr64e/Kconfig
```kconfig
config UPM_m24lr64e
    bool "m24lr64e"
    select MRAA
    select NEWLIB_LIBC
    depends on UPM
    default n
    help
        upm m24lr64esensor module
```

## src/max30100/Kconfig
```kconfig
config UPM_max30100
    bool "max30100"
    select MRAA
    select NEWLIB_LIBC
    depends on UPM
    default n
    help
        Pulse oximeter and heart-rate sensor
```

## src/mb704x/Kconfig
```kconfig
config UPM_mb704x
    bool "mb704x"
    select MRAA
    select NEWLIB_LIBC
    depends on UPM
    default n
    help
        upm MB704X MaxSonar-WR Ultrasonic Ranger
```

## src/mcp2515/Kconfig
```kconfig
config UPM_mcp2515
    bool "mcp2515"
    select MRAA
    select NEWLIB_LIBC
    depends on UPM
    default n
    help
        upm MCP2515 CAN bus controller
```

## src/md/Kconfig
```kconfig
config UPM_md
    bool "md"
    select MRAA
    select NEWLIB_LIBC
    depends on UPM
    default n
    help
        UPM driver for Grove Motor Driver (MD)
```
