## Kconfig
```kconfig
menu "UPM"
config UPM
    bool
    prompt "UPM Support"
    select NEWLIB_LIBC
    default n
    help
        This option enables the UPM sensor libraries

source "ext/lib/upm/src/a110x/Kconfig"
source "ext/lib/upm/src/ad8232/Kconfig"
source "ext/lib/upm/src/apa102/Kconfig"
source "ext/lib/upm/src/bh1750/Kconfig"
source "ext/lib/upm/src/collision/Kconfig"
source "ext/lib/upm/src/dfrorp/Kconfig"
source "ext/lib/upm/src/dfrph/Kconfig"
source "ext/lib/upm/src/emg/Kconfig"
source "ext/lib/upm/src/flex/Kconfig"
source "ext/lib/upm/src/gas/Kconfig"
source "ext/lib/upm/src/gp2y0a/Kconfig"
source "ext/lib/upm/src/gsr/Kconfig"
source "ext/lib/upm/src/hka5/Kconfig"
source "ext/lib/upm/src/joystick12/Kconfig"
source "ext/lib/upm/src/ldt0028/Kconfig"
source "ext/lib/upm/src/led/Kconfig"
source "ext/lib/upm/src/light/Kconfig"
source "ext/lib/upm/src/loudness/Kconfig"
source "ext/lib/upm/src/m24lr64e/Kconfig"
source "ext/lib/upm/src/mic/Kconfig"
source "ext/lib/upm/src/mma7361/Kconfig"
source "ext/lib/upm/src/moisture/Kconfig"
source "ext/lib/upm/src/mpr121/Kconfig"
source "ext/lib/upm/src/mq303a/Kconfig"
source "ext/lib/upm/src/nmea_gps/Kconfig"
source "ext/lib/upm/src/o2/Kconfig"
source "ext/lib/upm/src/relay/Kconfig"
source "ext/lib/upm/src/rotary/Kconfig"
source "ext/lib/upm/src/servo/Kconfig"
source "ext/lib/upm/src/sht1x/Kconfig"
source "ext/lib/upm/src/slide/Kconfig"
source "ext/lib/upm/src/temperature/Kconfig"
source "ext/lib/upm/src/tsl2561/Kconfig"
source "ext/lib/upm/src/ttp223/Kconfig"
source "ext/lib/upm/src/urm37/Kconfig"
source "ext/lib/upm/src/utilities/Kconfig"
source "ext/lib/upm/src/vdiv/Kconfig"
source "ext/lib/upm/src/water/Kconfig"
source "ext/lib/upm/src/yg1006/Kconfig"
source "ext/lib/upm/src/biss0001/Kconfig"
source "ext/lib/upm/src/bmi160/Kconfig"
endmenu
```

## src/a110x/Kconfig
```kconfig
config UPM_a110x
    bool "a110x"
    select MRAA
    select NEWLIB_LIBC
    depends on UPM
    default n
    help
        upm a110x sensor module
```

## src/ad8232/Kconfig
```kconfig
config UPM_ad8232
    bool "ad8232"
    select MRAA
    select NEWLIB_LIBC
    depends on UPM
    default n
    help
        upm ad8232sensor module
```

## src/apa102/Kconfig
```kconfig
config UPM_apa102
    bool "apa102"
    select MRAA
    select NEWLIB_LIBC
    depends on UPM
    default n
    help
        UPM driver for DFRobot HKA5 PM2.5 particle sensor
```

## src/bh1750/Kconfig
```kconfig
config UPM_bh1750
    bool "bh1750"
    select MRAA
    select NEWLIB_LIBC
    depends on UPM
    default n
    help
        upm dfrobot BH1750 I2C Digital Light Sensor
```

## src/biss0001/Kconfig
```kconfig
config UPM_biss0001
    bool "biss0001"
    select MRAA
    select NEWLIB_LIBC
    depends on UPM
    default n
    help
        upm biss0001 PIR motion sensor
```

## src/bma250e/Kconfig
```kconfig
config UPM_bma250e
    bool "bma250e"
    select MRAA
    select NEWLIB_LIBC
    depends on UPM
    default n
    help
        upm BMA250E 3-axis Accelerometer
```

## src/bmg160/Kconfig
```kconfig
config UPM_bmg160
    bool "bmg160"
    select MRAA
    select NEWLIB_LIBC
    depends on UPM
    default n
    help
        upm BMG160 3-axis Gyroscope
```

## src/bmi160/Kconfig
```kconfig
config UPM_bmi160
    bool "bmi160"
    select MRAA
    select NEWLIB_LIBC
    depends on UPM
    default n
    help
        upm BMI160 Accelerometer/Gyroscope
```

## src/bmm150/Kconfig
```kconfig
config UPM_bmm150
    bool "bmm150"
    select MRAA
    select NEWLIB_LIBC
    depends on UPM
    default n
    help
        upm BMM150 3-axis Geomagnetic Sensor
```

## src/bmp280/Kconfig
```kconfig
config UPM_bmp280
    bool "bmp280"
    select MRAA
    select NEWLIB_LIBC
    depends on UPM
    default n
    help
        upm BMP280/BME280 Environmental Sensor
```

## src/bmpx8x/Kconfig
```kconfig
config UPM_bmpx8x
    bool "bmpx8x"
    select MRAA
    select NEWLIB_LIBC
    depends on UPM
    default n
    help
        upm BMPX8X Pressure and Temperature Sensor
```

## src/bno055/Kconfig
```kconfig
config UPM_bno055
    bool "bno055"
    select MRAA
    select NEWLIB_LIBC
    depends on UPM
    default n
    help
        upm BNO055 Intelligent Absolute Orientation Sensor
```

## src/button/Kconfig
```kconfig
config UPM_button
    bool "button"
    select MRAA
    select NEWLIB_LIBC
    depends on UPM
    default n
    help
        upm button sensor module
```

## src/buzzer/Kconfig
```kconfig
config UPM_buzzer
    bool "buzzer"
    select MRAA
    select NEWLIB_LIBC
    depends on UPM
    default n
    help
        upm pwm audio buzzer
```

## src/cjq4435/Kconfig
```kconfig
config UPM_cjq4435
    bool "cjq4435"
    select MRAA
    select NEWLIB_LIBC
    depends on UPM
    default n
    help
        UPM CJQ4435 (MOSFET) module
```

## src/collision/Kconfig
```kconfig
config UPM_collision
    bool "collision"
    select MRAA
    select NEWLIB_LIBC
    depends on UPM
    default n
    help
        upm collisionsensor module
```

## src/dfrec/Kconfig
```kconfig
config UPM_dfrec
    bool "dfrec"
    select MRAA
    select NEWLIB_LIBC
    depends on UPM
    default n
    help
        upm dfrobot analog EC sensor
```

## src/dfrorp/Kconfig
```kconfig
config UPM_dfrorp
    bool "dfrorp"
    select MRAA
    select NEWLIB_LIBC
    depends on UPM
    default n
    help
        upm dfrobot analog ORP sensor
```

## src/dfrph/Kconfig
```kconfig
config UPM_dfrph
    bool "dfrph"
    select MRAA
    select NEWLIB_LIBC
    depends on UPM
    default n
    help
        upm dfrobot pH sensor
```

## src/ds18b20/Kconfig
```kconfig
config UPM_ds18b20
    bool "ds18b20"
    select MRAA
    select NEWLIB_LIBC
    depends on UPM
    default n
    help
        DS18B20 1-wire Temperature sensor
```

## src/ecezo/Kconfig
```kconfig
config UPM_ecezo
    bool "ecezo"
    select MRAA
    select NEWLIB_LIBC
    depends on UPM
    default n
    help
        upm EC-EZO EC Sensor
```

## src/emg/Kconfig
```kconfig
config UPM_emg
    bool "emg"
    select MRAA
    select NEWLIB_LIBC
    depends on UPM
    default n
    help
        upm emg muscle signal reader sensor module
```

## src/enc03r/Kconfig
```kconfig
config UPM_enc03r
    bool "enc03r"
    select MRAA
    select NEWLIB_LIBC
    depends on UPM
    default n
    help
        upm ENC03R single axis analog gyroscope
```

## src/flex/Kconfig
```kconfig
config UPM_flex
    bool "flex"
    select MRAA
    select NEWLIB_LIBC
    depends on UPM
    default n
    help
        upm flex sensor module
```
