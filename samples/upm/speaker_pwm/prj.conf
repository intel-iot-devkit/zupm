## prj.conf
```kconfig
CONFIG_STDOUT_CONSOLE=y
CONFIG_UPM=y
CONFIG_UPM_speaker=y
CONFIG_UPM_utilities=y

CONFIG_GPIO=y
CONFIG_GPIO_QMSI=y
CONFIG_MRAA=y
CONFIG_MRAA_GPIO=y

CONFIG_MRAA_PWM=y
CONFIG_PWM=y
CONFIG_PWM_QMSI=y
CONFIG_PWM_QMSI_DEV_NAME="PWM_0"
CONFIG_PWM_QMSI_NUM_PORTS=4
```

## src/speaker_pwm.c
```c
/*
 * Author: Jon Trulson <jtrulson@ics.com>
 * Copyright (c) 2017 Intel Corporation.
 *
 * Permission is hereby granted, free of charge, to any person obtaining
 * a copy of this software and associated documentation files (the
 * "Software"), to deal in the Software without restriction, including
 * without limitation the rights to use, copy, modify, merge, publish,
 * distribute, sublicense, and/or sell copies of the Software, and to
 * permit persons to whom the Software is furnished to do so, subject to
 * the following conditions:
 *
 * The above copyright notice and this permission notice shall be
 * included in all copies or substantial portions of the Software.
 *
 * THE SOFTWARE IS PROVIDED "AS IS", WITHOUT WARRANTY OF ANY KIND,
 * EXPRESS OR IMPLIED, INCLUDING BUT NOT LIMITED TO THE WARRANTIES OF
 * MERCHANTABILITY, FITNESS FOR A PARTICULAR PURPOSE AND
 * NONINFRINGEMENT. IN NO EVENT SHALL THE AUTHORS OR COPYRIGHT HOLDERS BE
 * LIABLE FOR ANY CLAIM, DAMAGES OR OTHER LIABILITY, WHETHER IN AN ACTION
 * OF CONTRACT, TORT OR OTHERWISE, ARISING FROM, OUT OF OR IN CONNECTION
 * WITH THE SOFTWARE OR THE USE OR OTHER DEALINGS IN THE SOFTWARE.
 */

#include <unistd.h>
#include <stdio.h>
#include "speaker.h"

int main ()
{
//! [Interesting]

    // Instantiate a Speaker (PWM) on digital pin D3
    speaker_context speaker = speaker_init_pwm(3);

    if (!speaker)
    {
        printf("speaker_init() failed\n");
        return 1;
    }

    // emit a series of frequencies for 500ms each
    speaker_emit(speaker, 50, 500);
    speaker_emit(speaker, 75, 500);
    speaker_emit(speaker, 125, 500);
    speaker_emit(speaker, 250, 500);
    speaker_emit(speaker, 500, 500);
    speaker_emit(speaker, 1000, 500);
    speaker_emit(speaker, 2000, 500);
    speaker_emit(speaker, 3000, 500);
    speaker_emit(speaker, 5000, 500);
    speaker_emit(speaker, 10000, 500);

    printf("Exiting\n");

    speaker_close(speaker);

//! [Interesting]

    return 0;
}
```
