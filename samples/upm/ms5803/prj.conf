## prj.conf
```kconfig
CONFIG_STDOUT_CONSOLE=y
CONFIG_MRAA=y
CONFIG_MRAA_I2C=y
CONFIG_MRAA_SPI=y
CONFIG_I2C=y
CONFIG_SPI=y
CONFIG_UPM=y
CONFIG_UPM_ms5803=y
CONFIG_UPM_utilities=y
```

## src/ms5803.c
```c
/*
 * Author: Jon Trulson <jtrulson@ics.com>
 * Copyright (c) 2016 Intel Corporation.
 *
 * Permission is hereby granted, free of charge, to any person obtaining
 * a copy of this software and associated documentation files (the
 * "Software"), to deal in the Software without restriction, including
 * without limitation the rights to use, copy, modify, merge, publish,
 * distribute, sublicense, and/or sell copies of the Software, and to
 * permit persons to whom the Software is furnished to do so, subject to
 * the following conditions:
 *
 * The above copyright notice and this permission notice shall be
 * included in all copies or substantial portions of the Software.
 *
 * THE SOFTWARE IS PROVIDED "AS IS", WITHOUT WARRANTY OF ANY KIND,
 * EXPRESS OR IMPLIED, INCLUDING BUT NOT LIMITED TO THE WARRANTIES OF
 * MERCHANTABILITY, FITNESS FOR A PARTICULAR PURPOSE AND
 * NONINFRINGEMENT. IN NO EVENT SHALL THE AUTHORS OR COPYRIGHT HOLDERS BE
 * LIABLE FOR ANY CLAIM, DAMAGES OR OTHER LIABILITY, WHETHER IN AN ACTION
 * OF CONTRACT, TORT OR OTHERWISE, ARISING FROM, OUT OF OR IN CONNECTION
 * WITH THE SOFTWARE OR THE USE OR OTHER DEALINGS IN THE SOFTWARE.
 */

#include <unistd.h>
#include <stdio.h>
#include <signal.h>

#include "ms5803.h"
#include "upm_utilities.h"

bool shouldRun = true;

void sig_handler(int signo)
{
  if (signo == SIGINT)
    shouldRun = false;
}

int main()
{
  signal(SIGINT, sig_handler);

//! [Interesting]

  // Instantiate a MS5803 on analog I2C bus 0, at the default address
//  ms5803_context sensor = ms5803_init(0, MS5803_DEFAULT_I2C_ADDR, -1);
  ms5803_context sensor = ms5803_init(0, -1, 2);

  if (!sensor)
  {
      printf("ms5803_init() failed\n");
      return 1;
  }

  // Every second, sample the sensor and output the pressure and
  // temperature

  while (shouldRun)
    {
        if (ms5803_update(sensor))
        {
            printf("ms5803_update() failed\n");
        }

        printf("Temperature: %f C, Pressure = %f mbar\n",
               ms5803_get_temperature(sensor),
               ms5803_get_pressure(sensor));

        upm_delay(1);
    }

//! [Interesting]

  printf("Exiting\n");

  ms5803_close(sensor);

  return 0;
}
```
