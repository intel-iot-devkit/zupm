## prj.conf
```kconfig
CONFIG_STDOUT_CONSOLE=y
CONFIG_MRAA=y
CONFIG_MRAA_AIO=y
CONFIG_ADC_QMSI_POLL=y
CONFIG_MRAA_GPIO=y
CONFIG_UPM=y
CONFIG_UPM_mq303a=y
CONFIG_UPM_utilities=y
CONFIG_GPIO=y
CONFIG_GPIO_QMSI_SS=y
CONFIG_ADC=y
```

## src/mq303a.c
```c
//Modified: Abhishek Malik <abhishek.malik@intel.com>

#include <stdio.h>
#include <stdlib.h>
#include <string.h>
#include <stdlib.h>
#include <unistd.h>
#include "mq303a.h"

#include "upm_utilities.h"
#include "mraa.h"

int main() {
    if (mraa_init() != MRAA_SUCCESS)
    {
        fprintf(stderr,"Failed to initialize mraa\n");
        return -1;
    }


    /* --------- MQ303A EXAMPLE -------- */
    mq303a_context dev = mq303a_init(0, 15);
    printf("init done for mq303a\n");
    int value;
    mq303a_heater_enable(dev, true);
    upm_delay(12);
    while(1){
        mq303a_get_value(dev, &value);
        printf("returned value: %d\n", value);
        upm_delay(1);
    }

    return 0;
}
```
