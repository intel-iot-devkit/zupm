## prj.conf
```kconfig
CONFIG_MRAA=y
CONFIG_UPM=y
CONFIG_UPM_button=y
CONFIG_UPM_utilities=y

CONFIG_GPIO=y
CONFIG_GPIO_QMSI=y
CONFIG_MRAA_GPIO=y
CONFIG_STDOUT_CONSOLE=y
```

## src/button.c
```c
/*
 * Authors: Abhishek Malik <abhishek.malik@intel.com>
 * Copyright (c) 2016 Intel Corporation.
 *
 * Permission is hereby granted, free of charge, to any person obtaining
 * a copy of this software and associated documentation files (the
 * "Software"), to deal in the Software without restriction, including
 * without limitation the rights to use, copy, modify, merge, publish,
 * distribute, sublicense, and/or sell copies of the Software, and to
 * permit persons to whom the Software is furnished to do so, subject to
 * the following conditions:
 *
 * The above copyright notice and this permission notice shall be
 * included in all copies or substantial portions of the Software.
 *
 * THE SOFTWARE IS PROVIDED "AS IS", WITHOUT WARRANTY OF ANY KIND,
 * EXPRESS OR IMPLIED, INCLUDING BUT NOT LIMITED TO THE WARRANTIES OF
 * MERCHANTABILITY, FITNESS FOR A PARTICULAR PURPOSE AND
 * NONINFRINGEMENT. IN NO EVENT SHALL THE AUTHORS OR COPYRIGHT HOLDERS BE
 * LIABLE FOR ANY CLAIM, DAMAGES OR OTHER LIABILITY, WHETHER IN AN ACTION
 * OF CONTRACT, TORT OR OTHERWISE, ARISING FROM, OUT OF OR IN CONNECTION
 * WITH THE SOFTWARE OR THE USE OR OTHER DEALINGS IN THE SOFTWARE.
 */

#include <stdio.h>
#include <stdlib.h>
#include <string.h>
#include <stdlib.h>
#include <unistd.h>
#include "button.h"

#include "upm_utilities.h"
#include "mraa.h"

int counter;

void button_isr(void *arg){
    counter++;
}

int main()
{
    counter = 0;
    if (mraa_init() != MRAA_SUCCESS)
    {
        fprintf(stderr,"Failed to initialize mraa\n");
        return -1;
    }

    button_context dev = button_init(2);

    button_install_isr(dev, MRAA_GPIO_EDGE_RISING, button_isr, NULL);
    while(1){
        printf("Interrupts: %d\n", counter);
        upm_delay(3);
    }

    return 0;
}
```
