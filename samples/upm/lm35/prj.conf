## prj.conf
```kconfig
CONFIG_STDOUT_CONSOLE=y
CONFIG_ADC=y
CONFIG_MRAA=y
CONFIG_MRAA_AIO=y
CONFIG_ADC_QMSI_POLL=y
CONFIG_UPM=y
CONFIG_UPM_lm35=y
CONFIG_UPM_utilities=y
```

## src/lm35.c
```c
/*
 * Author: Jon Trulson <jtrulson@ics.com>
 * Copyright (c) 2016 Intel Corporation.
 *
 * Permission is hereby granted, free of charge, to any person obtaining
 * a copy of this software and associated documentation files (the
 * "Software"), to deal in the Software without restriction, including
 * without limitation the rights to use, copy, modify, merge, publish,
 * distribute, sublicense, and/or sell copies of the Software, and to
 * permit persons to whom the Software is furnished to do so, subject to
 * the following conditions:
 *
 * The above copyright notice and this permission notice shall be
 * included in all copies or substantial portions of the Software.
 *
 * THE SOFTWARE IS PROVIDED "AS IS", WITHOUT WARRANTY OF ANY KIND,
 * EXPRESS OR IMPLIED, INCLUDING BUT NOT LIMITED TO THE WARRANTIES OF
 * MERCHANTABILITY, FITNESS FOR A PARTICULAR PURPOSE AND
 * NONINFRINGEMENT. IN NO EVENT SHALL THE AUTHORS OR COPYRIGHT HOLDERS BE
 * LIABLE FOR ANY CLAIM, DAMAGES OR OTHER LIABILITY, WHETHER IN AN ACTION
 * OF CONTRACT, TORT OR OTHERWISE, ARISING FROM, OUT OF OR IN CONNECTION
 * WITH THE SOFTWARE OR THE USE OR OTHER DEALINGS IN THE SOFTWARE.
 */

#include <unistd.h>
#include <stdio.h>
#include <signal.h>
#include "lm35.h"
#include "upm_utilities.h"

bool shouldRun = true;

void sig_handler(int signo)
{
  if (signo == SIGINT)
    shouldRun = false;
}

int main()
{
  signal(SIGINT, sig_handler);

//! [Interesting]

  // Instantiate a LM35 on analog pin A0, with a default analog
  // reference voltage of 5.0
  lm35_context sensor = lm35_init(0, 3.3);

  // Every half second, sample the sensor and output the temperature

  while (shouldRun)
    {
        float temp;
        if (lm35_get_temperature(sensor, &temp) != UPM_SUCCESS)
        {
            printf("lm35_get_temperature failed\n");
            return 1;
        }

#if defined(CONFIG_BOARD_QUARK_D2000_CRB)
        printf("Temperature: %d C\n", (int)temp);
#elif defined(CONFIG_BOARD_ARDUINO_101_SSS)
        printf("Temperature: %3.2f C\n", temp);
#endif

        upm_delay_ms(500);
    }

//! [Interesting]

  printf("Exiting\n");

  lm35_close(sensor);

  return 0;
}
```
