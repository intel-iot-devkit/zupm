## prj.conf
```kconfig
CONFIG_STDOUT_CONSOLE=y
CONFIG_MRAA=y
CONFIG_MRAA_I2C=y
CONFIG_I2C=y
CONFIG_UPM=y
CONFIG_UPM_mb704x=y
CONFIG_UPM_utilities=y
```

## src/mb704x.c
```c
/*
 * Author: Jon Trulson <jtrulson@ics.com>
 * Copyright (c) 2016 Intel Corporation.
 *
 * Permission is hereby granted, free of charge, to any person obtaining
 * a copy of this software and associated documentation files (the
 * "Software"), to deal in the Software without restriction, including
 * without limitation the rights to use, copy, modify, merge, publish,
 * distribute, sublicense, and/or sell copies of the Software, and to
 * permit persons to whom the Software is furnished to do so, subject to
 * the following conditions:
 *
 * The above copyright notice and this permission notice shall be
 * included in all copies or substantial portions of the Software.
 *
 * THE SOFTWARE IS PROVIDED "AS IS", WITHOUT WARRANTY OF ANY KIND,
 * EXPRESS OR IMPLIED, INCLUDING BUT NOT LIMITED TO THE WARRANTIES OF
 * MERCHANTABILITY, FITNESS FOR A PARTICULAR PURPOSE AND
 * NONINFRINGEMENT. IN NO EVENT SHALL THE AUTHORS OR COPYRIGHT HOLDERS BE
 * LIABLE FOR ANY CLAIM, DAMAGES OR OTHER LIABILITY, WHETHER IN AN ACTION
 * OF CONTRACT, TORT OR OTHERWISE, ARISING FROM, OUT OF OR IN CONNECTION
 * WITH THE SOFTWARE OR THE USE OR OTHER DEALINGS IN THE SOFTWARE.
 */

#include <unistd.h>
#include <signal.h>

#include <upm_utilities.h>
#include <mb704x.h>

bool shouldRun = true;

void sig_handler(int signo)
{
  if (signo == SIGINT)
    shouldRun = false;
}

int main()
{
    signal(SIGINT, sig_handler);

//! [Interesting]

    // Instantiate a MB704X sensor on i2c bus 0, address 112.
    printf("calling init....\n");
    mb704x_context sensor = mb704x_init(0, 112);

    if (!sensor)
    {
        printf("mb704x_init() failed.\n");
        return 1;
    }

    while (shouldRun)
    {
        // this will take about 1 second to complete
        int range = mb704x_get_range(sensor);
        if (range < 0)
        {
            printf("Error getting range.\n");
        }
        else
        {
            printf("Range: %d cm\n", range);
        }

        upm_delay_ms(500);
    }

    printf("Exiting\n");

    mb704x_close(sensor);

//! [Interesting]

    return 0;
}
```
