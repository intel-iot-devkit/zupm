## prj.conf
```kconfig
CONFIG_STDOUT_CONSOLE=y
CONFIG_MRAA=y
CONFIG_MRAA_GPIO=y
CONFIG_UPM=y
CONFIG_UPM_ppd42ns=y
CONFIG_UPM_utilities=y
CONFIG_GPIO=y
CONFIG_GPIO_QMSI=y
```

## src/ppd42ns.c
```c
/*
 * Author: Jon Trulson <jtrulson@ics.com>
 * Copyright (c) 2016 Intel Corporation.
 *
 * Permission is hereby granted, free of charge, to any person obtaining
 * a copy of this software and associated documentation files (the
 * "Software"), to deal in the Software without restriction, including
 * without limitation the rights to use, copy, modify, merge, publish,
 * distribute, sublicense, and/or sell copies of the Software, and to
 * permit persons to whom the Software is furnished to do so, subject to
 * the following conditions:
 *
 * The above copyright notice and this permission notice shall be
 * included in all copies or substantial portions of the Software.
 *
 * THE SOFTWARE IS PROVIDED "AS IS", WITHOUT WARRANTY OF ANY KIND,
 * EXPRESS OR IMPLIED, INCLUDING BUT NOT LIMITED TO THE WARRANTIES OF
 * MERCHANTABILITY, FITNESS FOR A PARTICULAR PURPOSE AND
 * NONINFRINGEMENT. IN NO EVENT SHALL THE AUTHORS OR COPYRIGHT HOLDERS BE
 * LIABLE FOR ANY CLAIM, DAMAGES OR OTHER LIABILITY, WHETHER IN AN ACTION
 * OF CONTRACT, TORT OR OTHERWISE, ARISING FROM, OUT OF OR IN CONNECTION
 * WITH THE SOFTWARE OR THE USE OR OTHER DEALINGS IN THE SOFTWARE.
 */

#include <unistd.h>
#include <stdio.h>
#include <signal.h>

#include <upm_utilities.h>
#include <ppd42ns.h>

int shouldRun = true;

void sig_handler(int signo)
{
    if (signo == SIGINT)
        shouldRun = false;
}


int main()
{
    signal(SIGINT, sig_handler);

//! [Interesting]
    // Instantiate a dust sensor on GPIO pin D8
    ppd42ns_context dust = ppd42ns_init(8);

    ppd42ns_dust_data data;
    printf("This program will give readings every 30 seconds until "
           "you stop it\n");

    while (shouldRun)
    {
        data = ppd42ns_get_data(dust);
        printf("Low pulse occupancy: %d\n", data.lowPulseOccupancy);
        printf("Ratio: %f\n", data.ratio);
        printf("Concentration: %f\n\n", data.concentration);
    }

    printf("Exiting...\n");

    ppd42ns_close(dust);

//! [Interesting]
    return 0;
}
```
