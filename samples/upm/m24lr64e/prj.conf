## prj.conf
```kconfig
CONFIG_STDOUT_CONSOLE=y
CONFIG_MRAA_I2C=y
CONFIG_I2C=y
CONFIG_MRAA=y
CONFIG_UPM=y
CONFIG_UPM_m24lr64e=y
CONFIG_UPM_utilities=y
```

## src/m24lr64e.c
```c
#include <stdio.h>
#include <stdlib.h>
#include <string.h>
#include <stdlib.h>
#include <unistd.h>
#include "m24lr64e.h"

#include "upm_utilities.h"
#include "mraa.h"

int main()
{
    if (mraa_init() != MRAA_SUCCESS)
    {
        fprintf(stderr,"Failed to initialize mraa\n");
        return -1;
    }

    m24lr64e_context dev = m24lr64e_init(0, M24LR64E_USER_MODE);
    int addr = M24LR64E_EEPROM_I2C_LENGTH-1;
    printf("address being accessed: %d\n", addr);
    uint8_t byte; 
    if(m24lr64e_read_byte(dev, addr, &byte) != UPM_SUCCESS)
        printf("error while reading value\n");
    printf("value read from the device: %d\n", byte);
    byte = ~byte;
    printf("byte to be written: %d\n", byte);
    if(m24lr64e_write_byte(dev, addr, byte) != UPM_SUCCESS)
        printf("error while writing byte to the device\n");
    uint8_t var;
    if(m24lr64e_read_byte(dev, addr, &var) != UPM_SUCCESS)
        printf("error while reading value back\n");
    printf("new value at %d: %d\n", addr, var);
    m24lr64e_close(dev);
    printf("all done!!\n");

    return 0;
}
```
