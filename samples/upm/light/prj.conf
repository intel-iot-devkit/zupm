## prj.conf
```kconfig
CONFIG_MRAA=y
CONFIG_UPM=y
CONFIG_UPM_light=y
CONFIG_UPM_utilities=y
CONFIG_ADC=y
CONFIG_MRAA_AIO=y
CONFIG_ADC_QMSI_POLL=y
```

## src/light.c
```c
/*
 * Author: Noel Eck <noel.eck@intel.com>
 * Copyright (c) 2016 Intel Corporation.
 *
 * Permission is hereby granted, free of charge, to any person obtaining
 * a copy of this software and associated documentation files (the
 * "Software"), to deal in the Software without restriction, including
 * without limitation the rights to use, copy, modify, merge, publish,
 * distribute, sublicense, and/or sell copies of the Software, and to
 * permit persons to whom the Software is furnished to do so, subject to
 * the following conditions:
 *
 * The above copyright notice and this permission notice shall be
 * included in all copies or substantial portions of the Software.
 *
 * THE SOFTWARE IS PROVIDED "AS IS", WITHOUT WARRANTY OF ANY KIND,
 * EXPRESS OR IMPLIED, INCLUDING BUT NOT LIMITED TO THE WARRANTIES OF
 * MERCHANTABILITY, FITNESS FOR A PARTICULAR PURPOSE AND
 * NONINFRINGEMENT. IN NO EVENT SHALL THE AUTHORS OR COPYRIGHT HOLDERS BE
 * LIABLE FOR ANY CLAIM, DAMAGES OR OTHER LIABILITY, WHETHER IN AN ACTION
 * OF CONTRACT, TORT OR OTHERWISE, ARISING FROM, OUT OF OR IN CONNECTION
 * WITH THE SOFTWARE OR THE USE OR OTHER DEALINGS IN THE SOFTWARE.
 */

#include <unistd.h>
#include <signal.h>

#include "light.h"
#include "upm_utilities.h"
#include "mraa.h"

bool shouldRun = true;

void sig_handler(int signo)
{
    if (signo == SIGINT)
        shouldRun = false;
}

int main()
{
    if (mraa_init() != MRAA_SUCCESS)
    {
        fprintf(stderr,"Failed to initialize mraa\n");
        return -1;
    }

    signal(SIGINT, sig_handler);

    //! [Interesting]

    // Instantiate a light sensor on analog pin A0
    light_context sensor = light_init(0);

    if (!sensor)
    {
        printf("light_init() failed.\n");
        return -1;
    }

    // Set the aref, scale, and offset
    light_set_aref(sensor, 5.0);
    light_set_scale(sensor, 1.0);
    light_set_offset(sensor, -.1);
    printf("aRef: %0.03f scale: %0.03f offset: %0.03f\n\n",
            light_get_aref(sensor),
            light_get_scale(sensor),
            light_get_offset(sensor));

    // Every half a second, sample the sensor output
    while (shouldRun)
    {
        float normalized = 0.0;
        float raw_volts = 0.0;
        float lux = 0.0;

        light_get_normalized(sensor, &normalized);
        light_get_raw_volts(sensor, &raw_volts);
        light_get_lux(sensor, &lux);

        printf("Normalized output: %0.03f, raw light sensor output: %0.03f v "
                "light output: %0.03f lux\n", normalized, raw_volts, lux);

        upm_delay_ms(500);
    }

    //! [Interesting]

    printf("Exiting\n");

    light_close(sensor);

    return 0;
}
```
